## conf/layer.conf
```bitbake
# We have a conf and classes directory, add to BBPATH
BBPATH .= ":${LAYERDIR}"

# We have recipes-* directories, add to BBFILES
BBFILES += "${LAYERDIR}/recipes-*/*/*.bb \
            ${LAYERDIR}/recipes-*/*/*.bbappend"

BBFILE_COLLECTIONS += "meta-pocketbeagle"
BBFILE_PATTERN_meta-pocketbeagle = "^${LAYERDIR}/"
BBFILE_PRIORITY_meta-pocketbeagle = "5"

LAYERSERIES_COMPAT_meta-pocketbeagle = "mickledore"
LAYERDEPENDS_meta-pocketbeagle = "core"
```

## conf/machine/pocketbeagle.conf
```bitbake
#@TYPE: Machine
#@NAME: pocketbeagle machine
#@DESCRIPTION: Pocketbeagle machine.

SOC_FAMILY = "ti-soc:ti33x"
require conf/machine/include/soc-family.inc
DEFAULT_TUNE ?= "armv7athf-neon"
require conf/machine/include/arm/armv7a/tune-cortexa8.inc

PREFERRED_PROVIDER_virtual/kernel ?= "linux-yocto"
KERNEL_IMAGETYPE = "zImage"
KERNEL_DEVICETREE = "am335x-pocketbeagle.dtb" 
KERNEL_EXTRA_ARGS += "LOADADDR=${UBOOT_ENTRYPOINT}"
KBUILD_DEFCONFIG = "omap2plus_defconfig"
KCONFIG_MODE = "alldefconfig"

PREFERRED_PROVIDER_virtual/bootloader = "u-boot"
PREFERRED_PROVIDER_u-boot = "u-boot"
SPL_BINARY = "MLO"
UBOOT_SUFFIX = "img"
UBOOT_MACHINE = "am335x_evm_defconfig"
UBOOT_ENTRYPOINT = "0x80008000"
UBOOT_LOADADDRESS = "0x80008000"

MACHINE_FEATURES = "usbgadget usbhost vfat alsa"
MACHINE_EXTRA_RRECOMMENDS = "kernel-modules kernel-devicetree"

EXTRA_IMAGEDEPENDS += "u-boot"
IMAGE_BOOT_FILES ?= "u-boot.${UBOOT_SUFFIX} ${SPL_BINARY} ${KERNEL_IMAGETYPE} ${KERNEL_DEVICETREE}"
IMAGE_FSTYPES += "wic.xz wic.bmap"
WKS_FILE ?= "pocketbeagle.wks"
IMAGE_INSTALL:append = " kernel-devicetree kernel-modules kernel-image-zimage"
WKS_FILE_DEPENDS = " \
	mtools-native \
	dosfstools-native \
	virtual/bootloader \
	virtual/kernel \
	bmap-tools-native \
	e2fsprogs-native \
	"

SERIAL_CONSOLES = "115200;ttyS0 115200;ttyO0"
SERIAL_CONSOLES_CHECK = "${SERIAL_CONSOLES}"
```

## wic/pocketbeagle.wks
```
# short-description: Create SD card image for PocketBeagle
# long-description: Creates a partitioned SD card image for PocketBeagle.
# Boot files are located in the first vfat partition.

part /boot --source bootimg-partition --ondisk mmcblk0 --fstype=vfat --label boot --active --align 4 --fixed-size 32 --sourceparams="loader=u-boot" --use-uuid
part / --source rootfs --ondisk mmcblk --fstype=ext4 --label root --align 4 --use-uuid
```
